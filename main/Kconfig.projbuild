## main/Kconfig.projbuild
```kconfig
menu "Project Configuration"

    menu "ESP-NOW Configuration"

        config ESPNOW_PMK
            string "ESP-NOW Primary Master Key (PMK)"
            default ""
            help
              Primary Master Key for ESP-NOW encryption (16 characters).
              Leave empty to disable encryption.
              All nodes in the same ESP-NOW network should use the same PMK.

        config ESPNOW_HEARTBEAT_TIMEOUT_S
            int "Heartbeat Timeout (seconds)"
            default 60
            range 10 600
            help
              If no heartbeat is received from a node within this period,
              the node will be marked as offline.

        config ESPNOW_HEARTBEAT_CHECK_S
            int "Heartbeat Check Interval (seconds)"
            default 10
            range 5 120
            help
              Interval at which the gateway scans the node table to detect
              nodes that have exceeded the heartbeat timeout.

    endmenu

    menu "Sensor Configuration"

        config SENSOR_SAMPLE_INTERVAL_S
            int "Sensor Sample Interval (seconds)"
            default 5
            range 1 3600
            help
              Interval in seconds between sensor readings (ENS160 + AHT21).

        config SENSOR_TEMP_COMP_X100
            int "Temperature Compensation (x100 °C)"
            default 0
            range -5000 5000
            help
              Manual temperature compensation value in hundredths of °C.
              For example, set to -150 to subtract 1.50 °C from the AHT21 reading.
              Useful to counteract the baking effect from nearby heat sources (e.g. ENS160).

        config SENSOR_HUM_COMP_X100
            int "Humidity Compensation (x100 %RH)"
            default 0
            range -5000 5000
            help
              Manual humidity compensation value in hundredths of %RH.
              For example, set to 200 to add 2.00 %RH to the AHT21 reading.
              Useful to counteract the baking effect from nearby heat sources (e.g. ENS160).

    endmenu

endmenu
```
